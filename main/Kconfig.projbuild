## main/Kconfig.projbuild
```kconfig
menu "ESP32-TUX Configuration"
    menu "Device Config"

    choice TUX_DEVICE_SELECTED
		default TUX_DEVICE_NONE
        prompt "Select the device"
		config TUX_DEVICE_NONE
			bool "Select a supported device"
        config TUX_DEVICE_ESP32S335D
            bool "MakerFabs ESP32S335D - 16Bit Parallel - 16MB Flash"
            help
                This is the device with 16MB Flash on a MakerFabs ESP32S3SPI35 - 16Bit Parallel device.

                The corresponding CSV file in the partition directory is
                partitions/partition-16MB.csv
        config TUX_DEVICE_ESP32S3SPI35
            bool "MakerFabs ESP32S3SPI35 - SPI - 16MB Flash"
            help
                This is the device with 16MB Flash on a MakerFabs ESP32S3SPI35 - SPI device.

                The corresponding CSV file in the partition directory is
                partitions/partition-16MB.csv

        config TUX_DEVICE_WT32_SC01
            bool "Wireless-Tag WT32-SC01 - SPI - 4MB Flash"
            help
                This is the device with 4MB Flash on a WT32-SC01 device.

                The corresponding CSV file in the partition directory is
                partitions/partition-4MB.csv

        config TUX_DEVICE_WT32_SC01_PLUS
            bool "Wireless-Tag WT32-SC01-Plus - 8Bit Parallel - 8MB Flash"
            help
                This is the device with 8MB Flash on a WT32-SC01-Plus device.

                The corresponding CSV file in the partition directory is
                partitions/partition-8MB.csv
    endchoice
    
    # TODO: Work in progress
    # config PARTITION_TABLE_CUSTOM_FILENAME  
    #     string "Selected custom filename"
    #     default "partitions/partition-4MB.csv" if TUX_DEVICE_WT32-SC01
    #     default "partitions/partition-8MB.csv" if TUX_DEVICE_WT32-SC01-PLUS
    #     default "partitions/partition-16MB.csv" if TUX_DEVICE_ESP32S3SPI35
    #     default "partitions/partition-16MB.csv" if TUX_DEVICE_ESP32S335D

    # config PARTITION_TABLE_FILENAME  
    #     string "Selected PARTITION_TABLE_FILENAME"
    #     default "partitions/partition-4MB.csv" if TUX_DEVICE_WT32-SC01
    #     default "partitions/partition-8MB.csv" if TUX_DEVICE_WT32-SC01-PLUS
    #     default "partitions/partition-16MB.csv" if TUX_DEVICE_ESP32S3SPI35
    #     default "partitions/partition-16MB.csv" if TUX_DEVICE_ESP32S335D   
        
    config PARTITION_TABLE_CUSTOM_FILENAME 
        string "Custom Partition CSV filename"    
    
    choice ESPTOOLPY_FLASHSIZE
        prompt "Flash size"
        default ESPTOOLPY_FLASHSIZE_4MB
        help
            SPI flash size, in megabytes
    endchoice

    config WALLPAPER_IMAGE
        bool
        default y
        prompt "Enable wallpaper image"
        help
            Enable wallpaper (background) image.

    endmenu
    menu "Wifi Provision Config"
    choice PROV_TRANSPORT
        bool "Provisioning Transport"
        default PROV_TRANSPORT_SOFTAP if IDF_TARGET_ESP32S2
        default PROV_TRANSPORT_SOFTAP
        help
            Wi-Fi provisioning component offers both, SoftAP and BLE transports. Choose any one.

        config PROV_TRANSPORT_BLE
            bool "BLE"
            select BT_ENABLED
            depends on !IDF_TARGET_ESP32S2
        config PROV_TRANSPORT_SOFTAP
            bool "Soft AP"
    endchoice

    config PROV_TRANSPORT
        int
        default 1 if PROV_TRANSPORT_BLE
        default 2 if PROV_TRANSPORT_SOFTAP

    config RESET_PROVISIONED
        bool
        default n
        prompt "Reset provisioned status of the device"
        help
            This erases the NVS to reset provisioned status of the device on every reboot.
            Provisioned status is determined by the Wi-Fi STA configuration, saved on the NVS.

    config RESET_PROV_MGR_ON_FAILURE
        bool
        default y
        prompt "Reset provisioned credentials and state machine after session failure"
        help
            Enable reseting provisioned credentials and state machine after session failure.
            This will restart the provisioning service after retries are exhausted.

    config PROV_MGR_MAX_RETRY_CNT
        int
        default 5
        prompt "Max retries before reseting provisioning state machine"
        depends on RESET_PROV_MGR_ON_FAILURE
        help
            Set the Maximum retry to avoid reconnecting to an inexistent AP or if credentials
            are misconfigured. Provisioned credentials are erased and internal state machine
            is reset after this threshold is reached.

    config PROV_SHOW_QR
        bool "Show provisioning QR code"
        default n
        help
            Show the QR code for provisioning.

    config PROV_USING_BLUEDROID
        bool
        depends on (BT_BLUEDROID_ENABLED && (IDF_TARGET_ESP32C3 || IDF_TARGET_ESP32S3))
        select BT_BLE_42_FEATURES_SUPPORTED
        default y
        help
            This enables BLE 4.2 features for Bluedroid.
    endmenu
    menu "MQTT Config"
        config BROKER_URL
            string 
            prompt "Enter MQTT Broker URL"
            default "mqtt://mqtt.eclipseprojects.io"
            help
                URL of the mqtt broker to connect to
    endmenu
    menu "SNTP Config"
        config TIMEZONE_STRING
            string 
            prompt "Enter Timezone String (TZ format)"
            default "UTC-05:30"
            help
                Refer TZ format database used with linux
        config SNTP_MAX_RETRY_COUNT
            int 
            default 10
            prompt "SNTP max retry count"
            help
                Set the Maximum retry to avoid failure of getting and setting device time.

        choice SNTP_TIME_SYNC_METHOD
            prompt "Time synchronization method"
            default SNTP_TIME_SYNC_METHOD_IMMED
            help
                Time synchronization method.

            config SNTP_TIME_SYNC_METHOD_IMMED
                bool "update time immediately when received"
            config SNTP_TIME_SYNC_METHOD_SMOOTH
                bool "update time with smooth method (adjtime)"
            config SNTP_TIME_SYNC_METHOD_CUSTOM
                bool "custom implementation"
        endchoice
    endmenu

    menu "OTA Config"
        config OTA_FIRMWARE_UPGRADE_URL
            string "Firmware Upgrade URL"
            default "https://192.168.1.128/build/ESP32-TUX.bin"
            help
                URL of server which hosts the firmware image.
    
        config OTA_FIRMWARE_UPGRADE_URL_FROM_STDIN
            bool
            default y if OTA_FIRMWARE_UPGRADE_URL = "FROM_STDIN"
    
        config OTA_SKIP_COMMON_NAME_CHECK
            bool "Skip server certificate CN fieldcheck"
            default y
            help
                This allows you to skip the validation of OTA server certificate CN field.
    
        config OTA_SKIP_VERSION_CHECK
            bool "Skip firmware version check"
            default n
            help
                This allows you to skip the firmware version check.
    
        config OTA_OTA_RECV_TIMEOUT
            int "OTA Receive Timeout"
            default 5000
            help
                Maximum time for reception
    
        config OTA_ENABLE_PARTIAL_HTTP_DOWNLOAD
            bool "Enable partial HTTP download"
            default n
            help
                This enables use of Range header in esp_https_ota component.
                Firmware image will be downloaded over multiple HTTP requests.
    
        config OTA_HTTP_REQUEST_SIZE
            int "HTTP request size"
            default MBEDTLS_SSL_IN_CONTENT_LEN
            depends on OTA_ENABLE_PARTIAL_HTTP_DOWNLOAD
            help
                This options specifies HTTP request size. Number of bytes specified
                in this option will be downloaded in single HTTP request.
    endmenu

    menu "Weather Config"
        config WEATHER_LOCATION
            string "Location for weather - city,country format"
            help
                Enter city and country name for getting weather for.

        choice WEATHER_UNITS
            prompt "Select Units for Weather display"
            default WEATHER_UNITS_METRIC
            config WEATHER_UNITS_STANDARD
                bool "Kelvin system - like ???..."
            config WEATHER_UNITS_METRIC
                bool "Metric system - like Celsius etc..."
            config WEATHER_UNITS_IMPERIAL
                bool "Imperial system - like Fahrenheit etc..."
        endchoice

        config WEATHER_OWM_URL
            string "Open Weather Map URL for Current Weather API"
            default "api.openweathermap.org"
            help
                URL of OpenWeatherMap.org API.
        config WEATHER_API_KEY
            string "OpenWeatherMap API Key for access"
            help
                Register on OpenWeatherMap.org for FREE limited API KEY        
        config WEATHER_LOCAL_URL
            string "Local URL for weather.json for testing"
            default "192.168.1.128"
            help
                URL of server where sample weather.json is available.    
    endmenu

endmenu
```

## sdkconfig.defaults
```kconfig
# CONFIG_ESPTOOLPY_FLASHSIZE_1MB is not set
# CONFIG_ESPTOOLPY_FLASHSIZE_2MB is not set
# CONFIG_ESPTOOLPY_FLASHSIZE_4MB is not set
CONFIG_ESPTOOLPY_FLASHSIZE_8MB=y
# CONFIG_ESPTOOLPY_FLASHSIZE_16MB  is not set
# CONFIG_ESPTOOLPY_FLASHSIZE_32MB is not set
# CONFIG_ESPTOOLPY_FLASHSIZE_64MB is not set
# CONFIG_ESPTOOLPY_FLASHSIZE_128MB is not set
CONFIG_ESPTOOLPY_FLASHSIZE="8MB"

#
# Partition Table
#
# CONFIG_PARTITION_TABLE_SINGLE_APP is not set
# CONFIG_PARTITION_TABLE_SINGLE_APP_LARGE is not set
# CONFIG_PARTITION_TABLE_TWO_OTA is not set
CONFIG_PARTITION_TABLE_CUSTOM=y
CONFIG_PARTITION_TABLE_CUSTOM_FILENAME="partitions/partition-8MB.csv"
CONFIG_PARTITION_TABLE_FILENAME="partitions/partition-8MB.csv"
# CONFIG_PARTITION_TABLE_OFFSET i not set
CONFIG_PARTITION_TABLE_MD5=y
# end of Partition Table

#
# ESP32-TUX Configuration
#

#
# Wifi Provision Config
#
# CONFIG_PROV_TRANSPORT_BLE is not set
CONFIG_PROV_TRANSPORT_SOFTAP=y
CONFIG_PROV_TRANSPORT=2
# CONFIG_RESET_PROVISIONED is not set
CONFIG_RESET_PROV_MGR_ON_FAILURE=y
CONFIG_PROV_MGR_MAX_RETRY_CNT=5
# CONFIG_PROV_SHOW_QR is not set
# end of Wifi Provision Config

#
# MQTT Config
#
CONFIG_BROKER_URL="mqtt://mqtt.eclipseprojects.io"
# end of MQTT Config

#
# SNTP Config
#
CONFIG_TIMEZONE_STRING="UTC-05:30"
CONFIG_SNTP_MAX_RETRY_COUNT=10
CONFIG_SNTP_TIME_SYNC_METHOD_IMMED=y
# CONFIG_SNTP_TIME_SYNC_METHOD_SMOOTH is not set
# CONFIG_SNTP_TIME_SYNC_METHOD_CUSTOM is not set
# end of SNTP Config

#
# OTA Config
#
CONFIG_OTA_FIRMWARE_UPGRADE_URL="https://192.168.1.128/build/ESP32-TUX.bin"
CONFIG_OTA_SKIP_COMMON_NAME_CHECK=y
# CONFIG_OTA_SKIP_VERSION_CHECK is not set
CONFIG_OTA_OTA_RECV_TIMEOUT=5000
# CONFIG_OTA_ENABLE_PARTIAL_HTTP_DOWNLOAD is not set
# CONFIG_PARTITION_TABLE_WT32SC01_4MB is not set
# CONFIG_PARTITION_TABLE_WT32SC01_8MB is not set
# CONFIG_PARTITION_TABLE_WT32SC01PLUS_4MB is not set
CONFIG_PARTITION_TABLE_WT32SC01PLUS_8MB=y
# end of OTA Config

CONFIG_LV_CONF_SKIP=not
```
